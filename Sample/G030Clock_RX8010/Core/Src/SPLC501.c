#include "main.h"
#include<string.h>	
#include "SPLC501.h"
/**************************************************************/
static unsigned char cursorx;
static unsigned char cursory;

char tmp[20];
/********************************************************************/

const unsigned char font[] = {
  
  0x00, 0x00, 0x00, 0x00, 0x00, 0x00, 0x00, 0x00, 0x00, 0x00,    // ' '
  0x00, 0x00, 0x00, 0x00, 0x0B, 0xF8, 0x00, 0x00, 0x00, 0x00,    // '!'
  0x00, 0x00, 0x00, 0x38, 0x00, 0x00, 0x00, 0x38, 0x00, 0x00,    // '"'
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  0x00, 0x38, 0x00, 0x44, 0x00, 0x44, 0x00, 0x44, 0x00, 0x38,    // ''
};			   



/*************************************************************/	
// Define LCD PinIO Mask 
/*************************************************************************************************************/
void lcd_rst_set(void){  HAL_GPIO_WritePin( LCD_RESET_GPIO_Port,LCD_RESET_Pin, GPIO_PIN_SET);}		// RS = 1 (Select Instruction)
void lcd_rst_clr(void){  HAL_GPIO_WritePin( LCD_RESET_GPIO_Port,LCD_RESET_Pin, GPIO_PIN_RESET);}				// RS = 0 (Select Data)
void lcd_cs_set(void){   HAL_GPIO_WritePin( LCD_CS_GPIO_Port,LCD_CS_Pin , GPIO_PIN_SET)	;}			// RW = 1 (Read)
void lcd_cs_clr(void){   HAL_GPIO_WritePin( LCD_CS_GPIO_Port,LCD_CS_Pin, GPIO_PIN_RESET);}		// RW = 0 (Write)
void lcd_A0_set(void){   HAL_GPIO_WritePin( LCD_A0_GPIO_Port,LCD_A0_Pin, GPIO_PIN_SET)	;}		// EN = 1 (Enable)
void lcd_A0_clr(void){   HAL_GPIO_WritePin( LCD_A0_GPIO_Port,LCD_A0_Pin, GPIO_PIN_RESET);}						// EN = 0 (Disable)
void lcd_wr_set(void){   HAL_GPIO_WritePin( LCD_WR_GPIO_Port,LCD_WR_Pin, GPIO_PIN_SET) ;}	  				// EN = 1 (Enable)
void lcd_wr_clr(void){   HAL_GPIO_WritePin( LCD_WR_GPIO_Port,LCD_WR_Pin, GPIO_PIN_RESET)	;}					// EN = 0 (Disable)
void lcd_rd_set(void){   HAL_GPIO_WritePin( LCD_RD_GPIO_Port,LCD_RD_Pin, GPIO_PIN_SET)  ;}					// EN = 1 (Enable)
void lcd_rd_clr(void){   HAL_GPIO_WritePin( LCD_RD_GPIO_Port,LCD_RD_Pin, GPIO_PIN_RESET) ;}						// EN = 0 (Disable)
/*********************************************************/
void delay(void)
{
  // double i;
  int i;
  for(i=0;i<1;i++)
  {
    i++;
  }
}

/**********************************************************/
void lcd_write(unsigned char data)
{
  lcd_A0_set();
  lcd_cs_clr();
  lcd_wr_clr();
  GPIOB->BSRR=(GPIOB->BSRR & 0Xff00) | data;
  lcd_wr_set();
  lcd_cs_set();
  GPIOB->BSRR = (uint32_t)0x00ff << 16U;
}		

void lcd_cmd(unsigned char control)
{
	lcd_rd_set();
  lcd_A0_clr();
  lcd_cs_clr();
  lcd_wr_clr();
  GPIOB->BSRR=(GPIOB->BSRR & 0Xff00) | control;
  lcd_wr_set();
  lcd_A0_set();	
  lcd_cs_set();
  GPIOB->BSRR = (uint32_t)0x00ff << 16U;
}
/***************************************************************/

void lcd_set_column( char cx,  char cy)
{
  lcd_cmd((cx) & 0x0f);
  lcd_cmd((((cx) & 0xf0) >> 4) | 0x10);
  lcd_cmd((cy & 0x0f) | 0xb0);
  return;
}

/***********************************************************/
void lcd_set_cursor(unsigned char cx, unsigned char cy)
{
  cursorx = cx;
  cursory = cy;
  lcd_set_column(cx*6, cy*1);
}
/************************************************************/
void lcd_char (char ch)
{
  unsigned int ptr;
  int q;
  lcd_set_cursor(cursorx, cursory);      
  ptr = (unsigned int)(((ch - 0x20)*10)+1);                  // point to low byte of font data
  
  for (q = 0; q < 5; q++){
    lcd_write(0x02);
    ptr+=2;
  }
  lcd_write(0);                                                      // the space between the words
  ptr = (unsigned int)(((ch - 0x20)*10));                  // point to high byte of font data
  lcd_set_column(cursorx*6, (cursory*2)+1);
  for (q = 0; q < 5; q++)
  {
    lcd_write(font[ptr]);
    ptr+=2;
  }
  lcd_write(0);
  cursorx++;
  if (cursorx == 20)
  {
    cursorx = 0;
    cursory++;
  }
  if (cursory > 3)
    cursory = 0;
}

/***********************************************************************/
void lcd_cls (void)
{
  int r, q;
  for (r=0; r<=8; r++)
  {
    lcd_set_column(0,r);      // set_column adds 4 to the position
    for (q=0; q<132; q++) 
    {
      lcd_write(0x0);
    }
  }
}
/**********************************************************************/

/***********************************************************************/
void lcd_init(void)

{
  lcd_wr_set();	 
  lcd_A0_set();  
  lcd_cs_set();  
  
  lcd_rd_set();
  lcd_rst_clr();
  HAL_Delay(50);
  lcd_rst_set();
  HAL_Delay(50);
  

  lcd_cmd(0xA0);      // <- ADC Direction L-R
  lcd_cmd(0xC8);      // <- SHL Direction 0-64
  lcd_cmd(0xA2);      // <- Voltage ref
  lcd_cmd(0x2C); // voltage converter on
  HAL_Delay(1);
  lcd_cmd(0x2E); // voltage regulator on
  
  HAL_Delay(1);
  
  lcd_cmd(0x2F); // voltage follower on
  lcd_cmd(0x27); // regulator resistor
  lcd_cmd(0x81); // set reference voltage 
  lcd_cmd(0x10); // reference voltage value (contraste)
  lcd_cmd(0xAF); // DiSP ON 
	lcd_cls();
  lcd_cmd(0xA5); // all on
  HAL_Delay(500);
  lcd_cmd(0xA4); // all off
}



/************************************************************/
void lcd_print (char * text)
{
  int q;
  // print a string to the lcd
  for (q=0; q<strlen(text); q++)
  {
    lcd_char(text[q]);
  }
}


char lcd_x = 0;
char lcd_y = 0;
//char column=0; 
char line=0; 
char contrast=10;
float t=0;


static const char ASCII[][5] ={
  {0x00, 0x00, 0x00, 0x00, 0x00} // 20
  ,{0x00, 0x00, 0x5f, 0x00, 0x00} // 21 !
  ,{0x00, 0x07, 0x00, 0x07, 0x00} // 22 "
  ,{0x14, 0x7f, 0x14, 0x7f, 0x14} // 23 #
  ,{0x24, 0x2a, 0x7f, 0x2a, 0x12} // 24 $
  ,{0x23, 0x13, 0x08, 0x64, 0x62} // 25 %
  ,{0x36, 0x49, 0x55, 0x22, 0x50} // 26 &
  ,{0x00, 0x05, 0x03, 0x00, 0x00} // 27 '
  ,{0x00, 0x1c, 0x22, 0x41, 0x00} // 28 (
  ,{0x00, 0x41, 0x22, 0x1c, 0x00} // 29 )
  ,{0x14, 0x08, 0x3e, 0x08, 0x14} // 2a *
  ,{0x08, 0x08, 0x3e, 0x08, 0x08} // 2b +
  ,{0x00, 0x50, 0x30, 0x00, 0x00} // 2c ,
  ,{0x08, 0x08, 0x08, 0x08, 0x08} // 2d -
  ,{0x00, 0x60, 0x60, 0x00, 0x00} // 2e .
  ,{0x20, 0x10, 0x08, 0x04, 0x02} // 2f /
  ,{0x3e, 0x51, 0x49, 0x45, 0x3e} // 30 0
  ,{0x00, 0x42, 0x7f, 0x40, 0x00} // 31 1
  ,{0x42, 0x61, 0x51, 0x49, 0x46} // 32 2
  ,{0x21, 0x41, 0x45, 0x4b, 0x31} // 33 3
  ,{0x18, 0x14, 0x12, 0x7f, 0x10} // 34 4
  ,{0x27, 0x45, 0x45, 0x45, 0x39} // 35 5
  ,{0x3c, 0x4a, 0x49, 0x49, 0x30} // 36 6
  ,{0x01, 0x71, 0x09, 0x05, 0x03} // 37 7
  ,{0x36, 0x49, 0x49, 0x49, 0x36} // 38 8
  ,{0x06, 0x49, 0x49, 0x29, 0x1e} // 39 9
  ,{0x00, 0x36, 0x36, 0x00, 0x00} // 3a :
  ,{0x00, 0x56, 0x36, 0x00, 0x00} // 3b ;
  ,{0x08, 0x14, 0x22, 0x41, 0x00} // 3c <
  ,{0x14, 0x14, 0x14, 0x14, 0x14} // 3d =
  ,{0x00, 0x41, 0x22, 0x14, 0x08} // 3e >
  ,{0x02, 0x01, 0x51, 0x09, 0x06} // 3f ?
  ,{0x32, 0x49, 0x79, 0x41, 0x3e} // 40 @
  ,{0x7e, 0x11, 0x11, 0x11, 0x7e} // 41 A
  ,{0x7f, 0x49, 0x49, 0x49, 0x36} // 42 B
  ,{0x3e, 0x41, 0x41, 0x41, 0x22} // 43 C
  ,{0x7f, 0x41, 0x41, 0x22, 0x1c} // 44 D
  ,{0x7f, 0x49, 0x49, 0x49, 0x41} // 45 E
  ,{0x7f, 0x09, 0x09, 0x09, 0x01} // 46 F
  ,{0x3e, 0x41, 0x49, 0x49, 0x7a} // 47 G
  ,{0x7f, 0x08, 0x08, 0x08, 0x7f} // 48 H
  ,{0x00, 0x41, 0x7f, 0x41, 0x00} // 49 I
  ,{0x20, 0x40, 0x41, 0x3f, 0x01} // 4a J
  ,{0x7f, 0x08, 0x14, 0x22, 0x41} // 4b K
  ,{0x7f, 0x40, 0x40, 0x40, 0x40} // 4c L
  ,{0x7f, 0x02, 0x0c, 0x02, 0x7f} // 4d M
  ,{0x7f, 0x04, 0x08, 0x10, 0x7f} // 4e N
  ,{0x3e, 0x41, 0x41, 0x41, 0x3e} // 4f O
  ,{0x7f, 0x09, 0x09, 0x09, 0x06} // 50 P
  ,{0x3e, 0x41, 0x51, 0x21, 0x5e} // 51 Q
  ,{0x7f, 0x09, 0x19, 0x29, 0x46} // 52 R
  ,{0x46, 0x49, 0x49, 0x49, 0x31} // 53 S
  ,{0x01, 0x01, 0x7f, 0x01, 0x01} // 54 T
  ,{0x3f, 0x40, 0x40, 0x40, 0x3f} // 55 U
  ,{0x1f, 0x20, 0x40, 0x20, 0x1f} // 56 V
  ,{0x3f, 0x40, 0x38, 0x40, 0x3f} // 57 W
  ,{0x63, 0x14, 0x08, 0x14, 0x63} // 58 X
  ,{0x07, 0x08, 0x70, 0x08, 0x07} // 59 Y
  ,{0x61, 0x51, 0x49, 0x45, 0x43} // 5a Z
  ,{0x00, 0x7f, 0x41, 0x41, 0x00} // 5b [
  ,{0x02, 0x04, 0x08, 0x10, 0x20} // 5c ¥
  ,{0x00, 0x41, 0x41, 0x7f, 0x00} // 5d ]
  ,{0x04, 0x02, 0x01, 0x02, 0x04} // 5e ^
  ,{0x40, 0x40, 0x40, 0x40, 0x40} // 5f _
  ,{0x00, 0x01, 0x02, 0x04, 0x00} // 60 `
  ,{0x20, 0x54, 0x54, 0x54, 0x78} // 61 a
  ,{0x7f, 0x48, 0x44, 0x44, 0x38} // 62 b
  ,{0x38, 0x44, 0x44, 0x44, 0x20} // 63 c
  ,{0x38, 0x44, 0x44, 0x48, 0x7f} // 64 d
  ,{0x38, 0x54, 0x54, 0x54, 0x18} // 65 e
  ,{0x08, 0x7e, 0x09, 0x01, 0x02} // 66 f
  ,{0x0c, 0x52, 0x52, 0x52, 0x3e} // 67 g
  ,{0x7f, 0x08, 0x04, 0x04, 0x78} // 68 h
  ,{0x00, 0x44, 0x7d, 0x40, 0x00} // 69 i
  ,{0x20, 0x40, 0x44, 0x3d, 0x00} // 6a j
  ,{0x7f, 0x10, 0x28, 0x44, 0x00} // 6b k
  ,{0x00, 0x41, 0x7f, 0x40, 0x00} // 6c l
  ,{0x7c, 0x04, 0x18, 0x04, 0x78} // 6d m
  ,{0x7c, 0x08, 0x04, 0x04, 0x78} // 6e n
  ,{0x38, 0x44, 0x44, 0x44, 0x38} // 6f o
  ,{0x7c, 0x14, 0x14, 0x14, 0x08} // 70 p
  ,{0x08, 0x14, 0x14, 0x18, 0x7c} // 71 q
  ,{0x7c, 0x08, 0x04, 0x04, 0x08} // 72 r
  ,{0x48, 0x54, 0x54, 0x54, 0x20} // 73 s
  ,{0x04, 0x3f, 0x44, 0x40, 0x20} // 74 t
  ,{0x3c, 0x40, 0x40, 0x20, 0x7c} // 75 u
  ,{0x1c, 0x20, 0x40, 0x20, 0x1c} // 76 v
  ,{0x3c, 0x40, 0x30, 0x40, 0x3c} // 77 w
  ,{0x44, 0x28, 0x10, 0x28, 0x44} // 78 x
  ,{0x0c, 0x50, 0x50, 0x50, 0x3c} // 79 y
  ,{0x44, 0x64, 0x54, 0x4c, 0x44} // 7a z
  ,{0x00, 0x08, 0x36, 0x41, 0x00} // 7b {
  ,{0x00, 0x00, 0x7f, 0x00, 0x00} // 7c |
  ,{0x00, 0x41, 0x36, 0x08, 0x00} // 7d }
  ,{0x10, 0x08, 0x08, 0x10, 0x08} // 7e ?
  ,{0x78, 0x46, 0x41, 0x46, 0x78} // 7f ?
};

void LcdCharacter(char character){
  lcd_write(0x00);
  for (int index = 0; index < 5; index++)
  {lcd_write( ASCII[character - 0x20][index]);
  }}

void LcdString(char *characters){
  while (*characters){
    LcdCharacter(*characters++);
  }
}

void LcdCharacter_neg(char character){
  lcd_write(0xff);
  for (int index = 0; index < 5; index++)
  {lcd_write( 0xff - ASCII[character - 0x20][index]);
  }}


void LcdString_neg(char *characters, uint8_t neg){
  if (neg==1){
    while (*characters){
      LcdCharacter_neg(*characters++);
    }
  }
  else {
    while (*characters){
      LcdCharacter(*characters++);
    }
  }
  
}



void draw_progbar(int value,int row){
  int index;
  if(value>72)value=72;
  lcd_set_column(0,row);
  lcd_write(0xff);
  lcd_write(0x81);
  for (index = 0; index < 72; index++)
  {if (index<value)lcd_write(0xbd);
  else lcd_write(0x81);
  }
  lcd_write(0x81);
  lcd_write(0xff);
}



uint8_t MediumNumbers[] =
{
  0x00, 0x00, 0x00, 0x80, 0x80, 0x80, 0x80, 0x80, 0x80, 0x00, 0x00, 0x00, 0x00, 0x00, 0x01, 0x03, 0x03, 0x03, 0x03, 0x03, 0x03, 0x01, 0x00, 0x00,   // -
  0x00, 0x00, 0x00, 0x00, 0x00, 0x00, 0x00, 0x00, 0x00, 0x00, 0x00, 0x00, 0x00, 0xc0, 0xc0, 0x00, 0x00, 0x00, 0x00, 0x00, 0x00, 0x00, 0x00, 0x00,   // .
  0x0C, 0x12, 0x12, 0x0C, 0x00, 0xC0, 0xF0, 0x7C, 0x3E, 0x0E, 0x02, 0x00, 0x80, 0xE0, 0xF8, 0x7C, 0x1F, 0x07, 0x01, 0x60, 0x90, 0x90, 0x60, 0x00,  // %
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  0x00, 0x00, 0x00, 0x00, 0x00, 0x00, 0x00, 0x00, 0x00, 0x00, 0x00, 0x00, 0x00, 0x00, 0x00, 0x00, 0x00, 0x00, 0x00, 0x00, 0x00, 0x00, 0x00, 0x00,   // ' '
};

uint8_t BigNumbers[] =
{
  0x00, 0x00, 0x00, 0x00, 0x00, 0x00, 0x00, 0x00, 0x00, 0x00, 0x00, 0x00,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 0x00,   // -
  0x00, 0x00, 0x00, 0x00, 0x00, 0x00, 0x00, 0x00, 0x00, 0x00, 0x00, 0x00,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 0x00,   // .
  0x00, 0x00, 0x02, 0x06, 0x0e, 0x0e, 0x0e, 0x0e, 0x0e, 0x0e, 0x06, 0x02,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 0x00,   // /
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  0x00, 0x00, 0x00, 0x00, 0x00, 0x00, 0x00, 0x00, 0x00, 0x00, 0x00, 0x00,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 0x00,   // ' '
};

void LCD_write_char_Medium (unsigned char X,unsigned char Y, unsigned char ch, char mode)
{
  unsigned char i, j;
  unsigned char ch_dat;
//  if(ch == ' ')
//    ch = 13;
//  else
//    ch = ch - 0x2d;
//
  // New character mapping with % support
  if (ch == '-')        ch = 0;
  else if (ch == '.')   ch = 1;
  else if (ch == '%')   ch = 2;        // <‑‑ NEW
  else if (ch == '/')   ch = 3;
  else if (ch == ':')   ch = 4;
  else if (ch >= '0' && ch <= '9')
      ch = 5 + (ch - '0');             // 0..9  → 4..13
  else if (ch == ' ')
      ch = 15;
  else
      return; // unsupported character

  for(i=0;i<2;i++)
  {	
    lcd_set_column ( X, Y+i);
    for(j=0; j<11; j++){
      
      ch_dat = MediumNumbers[(ch*24) + (i*12) +j];
      lcd_write((mode == 0)? ch_dat : (ch_dat^0xff));
    }}}

void LCD_write_string_Medium ( unsigned char X,unsigned char Y, char *string, char mode )
{
  while ( *string ){
    LCD_write_char_Medium( X, Y, *string , mode);
    if(*string++ == '.')
      X += 4;
    else
      X += 12;
  }}


/***********************************************************/
